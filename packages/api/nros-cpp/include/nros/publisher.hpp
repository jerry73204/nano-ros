// nros-cpp: Publisher class
// Freestanding C++ — no exceptions, no STL required

/**
 * @file publisher.hpp
 * @ingroup grp_pubsub
 * @brief `nros::Publisher<M>` — typed topic publisher.
 */

#ifndef NROS_CPP_PUBLISHER_HPP
#define NROS_CPP_PUBLISHER_HPP

#include <cstdint>
#include <cstddef>
#include <string.h> // memcpy — `<cstring>` isn't in Zephyr's minimal libcpp

#include "nros/config.hpp"
#include "nros/result.hpp"
// RFC-0088 D5 — NROS_CPP_ASSERT_MESSAGE_FORMAT, expanded in the creator below.
#include "nros/serialization_format.hpp"

#include "nros_cpp_ffi.h"

// phase-417 W1.a — the nested pointer aliases below (`Publisher<M>::SharedPtr`
// and friends, the spelling nearly every rclcpp source uses for a member) are
// `std::shared_ptr` / `std::unique_ptr`, so they need `<memory>` — which a
// MINIMAL freestanding libcpp does not ship (Zephyr's is `<cstddef>`,
// `<cstdint>`, `<new>`, plus this repo's `zephyr/cxx-compat/`; neither has
// `<memory>`).
//
// Gate on the declared std flavour, else ASK THE COMPILER. `__STDC_HOSTED__` is
// the WRONG question here (issue 0112), and measurably so: the Zephyr XRCE C++
// leaves compile with `-fno-freestanding -nostdinc++`, i.e. they read HOSTED
// while having no `<memory>` at all, and the aarch64 workspace leaf has
// `-nostdinc++` with no `-ffreestanding` either. `__has_include` answers the
// question that is actually being asked, and is the idiom
// `declared_qos.hpp:80` / `nros-c/include/nros/component.h:59` already use.
//
// The other entity headers repeat this block; the rationale lives here.
#if defined(NROS_CPP_STD)
#include <memory>
#define NROS_CPP_HAS_SHARED_PTR 1
#elif defined(__has_include)
#if __has_include(<memory>)
#include <memory>
#define NROS_CPP_HAS_SHARED_PTR 1
#endif
#endif

namespace nros {

/// Maximum topic name length stored inside `nros::Publisher<M>` (256).
/// The topic name is owned C++-side, not inside the runtime handle.
static constexpr size_t PUBLISHER_TOPIC_NAME_MAX = 256;

/// Typed publisher for a ROS 2 topic.
///
/// Mirrors `rclcpp::Publisher<M>`. The message type `M` must provide
/// `TYPE_NAME`, `TYPE_HASH`, and `ffi_publish()` (generated by codegen).
///
/// Raw CDR publishing is always available via `publish_raw()`.
///
/// Inline storage holds the runtime publisher handle directly
/// (`NROS_PUBLISHER_SIZE` bytes; size auto-derived from the runtime).
/// Topic name metadata lives C++-side in `topic_name_`, avoiding a
/// runtime hop for `get_topic_name()`.
///
/// Usage:
/// ```cpp
/// nros::Publisher<std_msgs::msg::String> pub;
/// NROS_TRY(node.create_publisher(pub, "/chatter"));
/// pub.publish_raw(cdr_data, cdr_len);
/// ```
template <typename M> class Publisher {
  public:
#ifdef NROS_CPP_HAS_SHARED_PTR
    /// `rclcpp::Publisher<M>::SharedPtr` — phase-417 W1.a.
    ///
    /// rclcpp indexes its entity types this way, and
    /// `rclcpp::Publisher<M>::SharedPtr member_;` is close to universal in
    /// ported source. Ergonomics only (RFC-0087 §"Who implements an adopted
    /// name"): a spelling for `std::shared_ptr<Publisher<M>>`, no second code path.
    ///
    /// Present only where `<memory>` is — a freestanding target has no
    /// `std::shared_ptr` to alias.
    using SharedPtr = std::shared_ptr<Publisher<M>>;
    /// `rclcpp::Publisher<M>::ConstSharedPtr` — see `SharedPtr`.
    using ConstSharedPtr = std::shared_ptr<const Publisher<M>>;
    /// `rclcpp::Publisher<M>::UniquePtr` — see `SharedPtr`.
    using UniquePtr = std::unique_ptr<Publisher<M>>;
#endif

    /// Publish a typed message.
    ///
    /// Calls the codegen-generated `M::ffi_publish()` which serializes the
    /// message to CDR and publishes it.
    Result publish(const M& msg) { return Result(M::ffi_publish(storage_, &msg)); }

    /// Publish raw CDR bytes.
    Result publish_raw(const uint8_t* data, size_t len) {
        if (!initialized_) return Result(ErrorCode::NotInitialized);
        return Result(nros_cpp_publish_raw(storage_, data, len));
    }

    /// Phase 124.E.1 — streamed publish.
    ///
    /// `total_len` declares the full payload size; `writer` is
    /// invoked one or more times with a writable chunk and must
    /// return the bytes written. The runtime/backend allocates
    /// `total_len` bytes (in the outbound buffer when the backend
    /// natively streams, otherwise in a stack staging buffer
    /// capped at ~4 KiB) and drains the closure until full.
    ///
    /// `writer` signature: `size_t(uint8_t* chunk, size_t cap)`.
    template <typename W> Result publish_streamed(size_t total_len, W&& writer) {
        if (!initialized_) return Result(ErrorCode::NotInitialized);
        struct Ctx {
            W writer;
            size_t total;
        } ctx{static_cast<W&&>(writer), total_len};
        auto size_cb = [](size_t* out_total, void* user) {
            auto* c = static_cast<Ctx*>(user);
            *out_total = c->total;
        };
        auto chunk_cb = [](uint8_t* out_buf, size_t cap, size_t* out_written, void* user) {
            auto* c = static_cast<Ctx*>(user);
            *out_written = c->writer(out_buf, cap);
        };
        return Result(nros_cpp_publisher_publish_streamed(storage_, size_cb, chunk_cb,
                                                          static_cast<void*>(&ctx)));
    }

    // ====================================================================
    // Phase 124.A.7 — zero-copy publish (loan / commit / discard)
    // ====================================================================

    /// Phase 124.A.7 — writable slot returned by `Publisher::loan`. RAII:
    /// `commit(actual_len)` sends + consumes; `discard()` abandons + consumes;
    /// `Drop` without either calls discard automatically.
    class Loan {
      public:
        Loan() : pub_(nullptr), buf_(nullptr), cap_(0), token_(nullptr) {}
        Loan(Loan&& o) : pub_(o.pub_), buf_(o.buf_), cap_(o.cap_), token_(o.token_) {
            o.pub_ = nullptr;
            o.token_ = nullptr;
        }
        Loan& operator=(Loan&& o) {
            if (this != &o) {
                release();
                pub_ = o.pub_;
                buf_ = o.buf_;
                cap_ = o.cap_;
                token_ = o.token_;
                o.pub_ = nullptr;
                o.token_ = nullptr;
            }
            return *this;
        }
        Loan(const Loan&) = delete;
        Loan& operator=(const Loan&) = delete;
        ~Loan() { release(); }

        /// Writable view of the loaned bytes.
        uint8_t* data() { return buf_; }
        const uint8_t* data() const { return buf_; }
        size_t capacity() const { return cap_; }

        bool is_valid() const { return token_ != nullptr; }

        /// Send `actual_len` bytes. Consumes the loan.
        Result commit(size_t actual_len) {
            if (!token_) return Result(ErrorCode::NotInitialized);
            nros_cpp_ret_t ret = nros_cpp_publisher_commit(pub_, token_, actual_len);
            pub_ = nullptr;
            token_ = nullptr;
            buf_ = nullptr;
            cap_ = 0;
            return Result(ret);
        }

        /// Abandon without sending. Consumes the loan.
        Result discard() {
            if (!token_) return Result::success();
            nros_cpp_ret_t ret = nros_cpp_publisher_discard(pub_, token_);
            pub_ = nullptr;
            token_ = nullptr;
            buf_ = nullptr;
            cap_ = 0;
            return Result(ret);
        }

        /// Internal constructor — callers use `Publisher::loan()` not
        /// this directly.
        Loan(void* pub, uint8_t* buf, size_t cap, void* token)
            : pub_(pub), buf_(buf), cap_(cap), token_(token) {}

      private:
        void release() {
            if (token_ && pub_) {
                nros_cpp_publisher_discard(pub_, token_);
                token_ = nullptr;
            }
        }

        void* pub_;
        uint8_t* buf_;
        size_t cap_;
        void* token_;
    };

    /// Loan a writable slot of at least `requested_len` bytes. The returned
    /// `Loan` is RAII: call `commit(actual_len)` to send, `discard()` to
    /// abandon, or let it drop (auto-discard).
    Expected<Loan> loan(size_t requested_len) {
        if (!initialized_) return Expected<Loan>::error(Result(ErrorCode::NotInitialized));
        uint8_t* buf = nullptr;
        size_t cap = 0;
        void* token = nullptr;
        nros_cpp_ret_t ret = nros_cpp_publisher_loan(storage_, requested_len, &buf, &cap, &token);
        if (ret != 0) return Expected<Loan>::error(Result(ret));
        return Expected<Loan>::ok(Loan{storage_, buf, cap, token});
    }

    /// Get the topic name.
    const char* get_topic_name() const { return initialized_ ? topic_name_ : ""; }

    /// Check if the publisher is initialized and valid.
    bool is_valid() const { return initialized_; }

    /// Destructor — releases publisher resources.
    ~Publisher() {
        if (initialized_) {
            nros_cpp_publisher_destroy(storage_);
            initialized_ = false;
        }
    }

    // Move semantics (non-copyable). Relocation goes through the
    // `nros_cpp_publisher_relocate` runtime call.
    Publisher(Publisher&& other) : initialized_(other.initialized_) {
        if (other.initialized_) {
            nros_cpp_publisher_relocate(other.storage_, storage_);
            ::memcpy(topic_name_, other.topic_name_, sizeof(topic_name_));
            other.initialized_ = false;
        }
    }

    Publisher& operator=(Publisher&& other) {
        if (this != &other) {
            if (initialized_) {
                nros_cpp_publisher_destroy(storage_);
                initialized_ = false;
            }
            if (other.initialized_) {
                nros_cpp_publisher_relocate(other.storage_, storage_);
                ::memcpy(topic_name_, other.topic_name_, sizeof(topic_name_));
                initialized_ = true;
                other.initialized_ = false;
            }
        }
        return *this;
    }

    /// Default constructor — creates an uninitialized publisher.
    /// Use `Node::create_publisher()` to initialize.
    Publisher() : storage_(), topic_name_{}, initialized_(false) {}

    // ====================================================================
    // Phase 108 — status events
    // ====================================================================

    /// Register a callback for liveliness-lost events on this publisher.
    Result on_liveliness_lost(nros_cpp_publisher_count_cb_t cb, void* user_context = nullptr) {
        if (!initialized_) return Result(ErrorCode::NotInitialized);
        return Result(nros_cpp_publisher_set_liveliness_lost(storage_, cb, user_context));
    }

    /// Register a callback for offered-deadline-missed events on this
    /// publisher.
    Result on_offered_deadline_missed(uint32_t deadline_ms, nros_cpp_publisher_count_cb_t cb,
                                      void* user_context = nullptr) {
        if (!initialized_) return Result(ErrorCode::NotInitialized);
        return Result(nros_cpp_publisher_set_offered_deadline_missed(storage_, deadline_ms, cb,
                                                                     user_context));
    }

    /// Phase 108.B.7 — manually assert liveliness. Required for
    /// publishers configured with `LivelinessManualByTopic` /
    /// `ManualByNode`; no-op for `Automatic` / `None`.
    Result assert_liveliness() {
        if (!initialized_) return Result(ErrorCode::NotInitialized);
        return Result(nros_cpp_publisher_assert_liveliness(storage_));
    }

  private:
    Publisher(const Publisher&) = delete;
    Publisher& operator=(const Publisher&) = delete;

    friend class Node;

    alignas(8) uint8_t storage_[NROS_PUBLISHER_SIZE];
    char topic_name_[PUBLISHER_TOPIC_NAME_MAX];
    bool initialized_;
};

} // namespace nros

// Phase 84.G8: out-of-line definition of Node::create_publisher<M>().
// Placed here so consumers only pay for this template when they actually
// use publishers — including `nros/node.hpp` alone no longer drags in
// every entity's code path.
#include "nros/node.hpp"

namespace nros {

template <typename M>
Result Node::create_publisher(Publisher<M>& out, const char* topic, const QoS& qos) {
    // RFC-0088 D5 — one image, one backend, one encoding. Compile-time, so a
    // message the linked backend cannot encode never reaches the wire.
    NROS_CPP_ASSERT_MESSAGE_FORMAT(M);
    if (!initialized_) return Result(ErrorCode::NotInitialized);
    nros_cpp_qos_t ffi_qos = detail::qos_to_ffi(qos);
    nros_cpp_ret_t ret = nros_cpp_publisher_create(&handle_, topic, M::TYPE_NAME, M::TYPE_HASH,
                                                   ffi_qos, out.storage_);
    if (ret == 0) {
        // Topic name lives C++-side; copy + null-terminate into the
        // fixed-size buffer. Truncation is silent.
        size_t topic_len = 0;
        while (topic[topic_len] != '\0' && topic_len + 1 < sizeof(out.topic_name_)) {
            out.topic_name_[topic_len] = topic[topic_len];
            ++topic_len;
        }
        out.topic_name_[topic_len] = '\0';
        out.initialized_ = true;
    }
    return Result(ret);
}

/// Phase 189.M3.1 — named-options overload. `PublisherOptions` is a
/// reserved/empty struct (a publisher has no callback ⇒ no sched-context
/// or message-info axis), so this simply forwards to the qos-only create.
/// It exists for rclcpp symmetry and as the seam for future intra-process
/// / loaned-message knobs.
template <typename M>
Result Node::create_publisher(Publisher<M>& out, const char* topic, const QoS& qos,
                              const PublisherOptions& options) {
    (void)options; // reserved — no live fields today
    return create_publisher<M>(out, topic, qos);
}

/// Phase 123.B.4 — value-returning publisher factory. Wraps the
/// out-param `Node::create_publisher` in `Expected<Publisher<M>>`
/// so users can write
/// `auto pub = nros::create_publisher<Int32>(node, "/chatter");`
/// in the rclcpp-style.
template <typename M>
inline Expected<Publisher<M>> create_publisher(Node& node, const char* topic,
                                               const QoS& qos = QoS::default_profile()) {
    Publisher<M> p;
    Result r = node.create_publisher<M>(p, topic, qos);
    if (!r.ok()) return Expected<Publisher<M>>::error(r);
    return Expected<Publisher<M>>::ok(std::move(p));
}

} // namespace nros

// ============================================================================
// rclcpp:: — the ROS 2 spelling (RFC-0087 stage 6, step A)
// ============================================================================
//
// Moved here from `nros/rclcpp_compat.hpp`, which no longer carries a surface
// of its own: RFC-0087 §"Naming: replace, with alias as the migration step"
// makes the ROS 2 spelling a first-class name declared by the API header that
// owns the concept, at which point a shim has nothing left to bridge.

// `rclcpp::Publisher<M>::SharedPtr` — rclcpp users index types this way, and
// they can: the nested `SharedPtr` / `ConstSharedPtr` / `UniquePtr` aliases
// live on `nros::Publisher<M>` itself (phase-417 W1.a), so the alias template
// carries them through with no wrapper type in between.
//
// `detail::SharedPtrTrait` was written for this job in phase 209 and never
// wired up. It was DELETED rather than adopted: a trait cannot make
// `T::SharedPtr` resolve (that spelling has to be a member of `T`), so it could
// never have done the job it was named for.
namespace rclcpp {
template <typename M> using Publisher = ::nros::Publisher<M>;
} // namespace rclcpp

#endif // NROS_CPP_PUBLISHER_HPP
