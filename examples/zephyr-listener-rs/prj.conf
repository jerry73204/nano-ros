## CMakeLists.txt
```
# SPDX-License-Identifier: Apache-2.0
# nano-ros Zephyr Listener Example (Rust)
#
# A ROS 2 compatible subscriber running on Zephyr RTOS using nano-ros.
#
# Build:
#   source ~/nano-ros-workspace/env.sh
#   west build -b native_sim/native/64 nano-ros/examples/zephyr-listener-rs
#
# Run:
#   ./build/zephyr/zephyr.exe

cmake_minimum_required(VERSION 3.20.0)

find_package(Zephyr REQUIRED HINTS $ENV{ZEPHYR_BASE})
project(nano_ros_listener_rs)

# C shim for zenoh-pico FFI
target_sources(app PRIVATE src/zenoh_shim.c)

# Build Rust application (zephyr-lang-rust is in west manifest)
rust_cargo_application()
```

## prj.conf
```kconfig
# nano-ros Zephyr Listener (Rust) Configuration
#
# This configuration enables Rust support, zenoh-pico, and networking.

# =============================================================================
# General
# =============================================================================
CONFIG_MAIN_STACK_SIZE=16384
CONFIG_HEAP_MEM_POOL_SIZE=65536
CONFIG_SYSTEM_WORKQUEUE_STACK_SIZE=4096

# =============================================================================
# Rust Support (zephyr-lang-rust)
# =============================================================================
CONFIG_RUST=y
CONFIG_RUST_ALLOC=y

# Use printk backend for logging (not RTT)
CONFIG_LOG_BACKEND_RTT=n

# =============================================================================
# Logging
# =============================================================================
CONFIG_LOG=y
CONFIG_LOG_DEFAULT_LEVEL=3
CONFIG_PRINTK=y
CONFIG_EARLY_CONSOLE=y

# =============================================================================
# Networking
# =============================================================================
CONFIG_NETWORKING=y
CONFIG_NET_IPV4=y
CONFIG_NET_TCP=y
CONFIG_NET_UDP=y
CONFIG_NET_SOCKETS=y

# Network buffers
CONFIG_NET_PKT_RX_COUNT=32
CONFIG_NET_PKT_TX_COUNT=32
CONFIG_NET_BUF_RX_COUNT=64
CONFIG_NET_BUF_TX_COUNT=64
CONFIG_NET_MAX_CONTEXTS=16

# Network interface
CONFIG_NET_L2_ETHERNET=y

# Static IP configuration (different from talker)
CONFIG_NET_CONFIG_SETTINGS=y
CONFIG_NET_CONFIG_NEED_IPV4=y
CONFIG_NET_CONFIG_MY_IPV4_ADDR="192.0.2.3"
CONFIG_NET_CONFIG_MY_IPV4_GW="192.0.2.2"
CONFIG_NET_CONFIG_MY_IPV4_NETMASK="255.255.255.0"

# DNS (optional)
CONFIG_DNS_RESOLVER=n

# =============================================================================
# POSIX API (required by zenoh-pico)
# =============================================================================
CONFIG_POSIX_API=y

# =============================================================================
# zenoh-pico
# =============================================================================
CONFIG_ZENOH_PICO=y
CONFIG_ZENOH_PICO_SUBSCRIPTION=y
CONFIG_ZENOH_PICO_LINK_TCP=y
CONFIG_ZENOH_PICO_MULTI_THREAD=y

# =============================================================================
# Timing
# =============================================================================
CONFIG_SYS_CLOCK_TICKS_PER_SEC=1000

# =============================================================================
# Debug
# =============================================================================
CONFIG_DEBUG=y
CONFIG_DEBUG_INFO=y
```

## src/main_stub.c
```c
/*
 * nano-ros Zephyr Listener - C Stub
 *
 * This stub provides the Zephyr entry point and calls the Rust main function.
 * The actual application logic is in src/lib.rs (Rust).
 *
 * SPDX-License-Identifier: Apache-2.0
 */

#include <zephyr/kernel.h>

/* Rust entry point - defined in src/lib.rs */
extern void main(void);
```

## src/zenoh_shim.c
```c
/**
 * zenoh-pico shim for Rust FFI (subscriber)
 *
 * This file provides wrapper functions that handle zenoh-pico types
 * with correct memory management, avoiding struct size mismatches in Rust FFI.
 */

#include <zenoh-pico.h>
#include <string.h>

// Callback function type for Rust
typedef void (*rust_sample_callback_t)(const uint8_t *data, size_t len, void *ctx);

// Static storage for zenoh objects (single subscriber use case)
static z_owned_config_t g_config;
static z_owned_session_t g_session;
static z_owned_subscriber_t g_subscriber;

// Callback storage
static rust_sample_callback_t g_callback = NULL;
static void *g_callback_ctx = NULL;

/**
 * Internal callback that receives zenoh samples and forwards to Rust
 */
static void sample_handler(z_loaned_sample_t *sample, void *arg) {
    (void)arg;

    if (g_callback == NULL) {
        return;
    }

    // Get payload
    const z_loaned_bytes_t *payload = z_sample_payload(sample);

    // Copy bytes to slice
    z_owned_slice_t slice;
    if (z_bytes_to_slice(payload, &slice) == 0) {
        const uint8_t *data = z_slice_data(z_slice_loan(&slice));
        size_t len = z_slice_len(z_slice_loan(&slice));
        g_callback(data, len, g_callback_ctx);
        z_slice_drop(z_slice_move(&slice));
    }
}

/**
 * Initialize zenoh config with client mode and connect locator
 */
int zenoh_init_config(const char *locator) {
    z_config_default(&g_config);

    if (zp_config_insert(z_config_loan_mut(&g_config), Z_CONFIG_MODE_KEY, "client") < 0) {
        return -1;
    }

    if (locator != NULL) {
        if (zp_config_insert(z_config_loan_mut(&g_config), Z_CONFIG_CONNECT_KEY, locator) < 0) {
            return -2;
        }
    }

    return 0;
}

/**
 * Open zenoh session and start background tasks
 */
int zenoh_open_session(void) {
    if (z_open(&g_session, z_config_move(&g_config), NULL) < 0) {
        return -1;
    }

    if (zp_start_read_task(z_session_loan_mut(&g_session), NULL) < 0) {
        z_close(z_session_loan_mut(&g_session), NULL);
        return -2;
    }

    if (zp_start_lease_task(z_session_loan_mut(&g_session), NULL) < 0) {
        zp_stop_read_task(z_session_loan_mut(&g_session));
        z_close(z_session_loan_mut(&g_session), NULL);
        return -3;
    }

    return 0;
}

/**
 * Declare a subscriber for the given key expression
 */
int zenoh_declare_subscriber(const char *keyexpr, rust_sample_callback_t callback, void *ctx) {
    g_callback = callback;
    g_callback_ctx = ctx;

    z_view_keyexpr_t ke;
    if (z_view_keyexpr_from_str(&ke, keyexpr) < 0) {
        return -1;
    }

    // Create closure for callback
    z_owned_closure_sample_t closure;
    z_closure_sample(&closure, sample_handler, NULL, NULL);

    if (z_declare_subscriber(z_session_loan(&g_session), &g_subscriber,
                             z_view_keyexpr_loan(&ke), z_closure_sample_move(&closure), NULL) < 0) {
        return -2;
    }

    return 0;
}

/**
 * Close the session and clean up
 */
void zenoh_close(void) {
    z_undeclare_subscriber(z_subscriber_move(&g_subscriber));
    zp_stop_lease_task(z_session_loan_mut(&g_session));
    zp_stop_read_task(z_session_loan_mut(&g_session));
    z_close(z_session_loan_mut(&g_session), NULL);
    g_callback = NULL;
    g_callback_ctx = NULL;
}
```
