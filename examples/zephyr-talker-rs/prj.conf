## CMakeLists.txt
```
# SPDX-License-Identifier: Apache-2.0
# nano-ros Zephyr Talker Example (Rust)
#
# A ROS 2 compatible publisher running on Zephyr RTOS using nano-ros.
#
# Build:
#   source ~/nano-ros-workspace/env.sh
#   west build -b native_sim/native/64 nano-ros/examples/zephyr-talker-rs
#
# Run:
#   ./build/zephyr/zephyr.exe

cmake_minimum_required(VERSION 3.20.0)

find_package(Zephyr REQUIRED HINTS $ENV{ZEPHYR_BASE})
project(nano_ros_talker_rs)

# C shim for zenoh-pico FFI
target_sources(app PRIVATE src/zenoh_shim.c)

# Build Rust application (zephyr-lang-rust is in west manifest)
rust_cargo_application()
```

## prj.conf
```kconfig
# nano-ros Zephyr Talker (Rust) Configuration
#
# This configuration enables the necessary Zephyr subsystems
# for running nano-ros with zenoh-pico transport.

# =============================================================================
# General
# =============================================================================
CONFIG_MAIN_STACK_SIZE=8192
CONFIG_HEAP_MEM_POOL_SIZE=32768
CONFIG_SYSTEM_WORKQUEUE_STACK_SIZE=4096

# =============================================================================
# Rust Support (zephyr-lang-rust)
# =============================================================================
CONFIG_RUST=y

# =============================================================================
# Networking (required for zenoh-pico)
# =============================================================================
CONFIG_NETWORKING=y
CONFIG_NET_IPV4=y
CONFIG_NET_TCP=y
CONFIG_NET_UDP=y
CONFIG_NET_SOCKETS=y
CONFIG_NET_SOCKETS_POSIX_NAMES=y

# Network buffers
CONFIG_NET_PKT_RX_COUNT=32
CONFIG_NET_PKT_TX_COUNT=32
CONFIG_NET_BUF_RX_COUNT=64
CONFIG_NET_BUF_TX_COUNT=64
CONFIG_NET_MAX_CONTEXTS=16

# Network interface
CONFIG_NET_L2_ETHERNET=y

# =============================================================================
# QEMU Networking
# =============================================================================
# For QEMU with TAP interface (default for qemu_x86)
CONFIG_NET_QEMU_ETHERNET=y

# Static IP configuration
CONFIG_NET_CONFIG_SETTINGS=y
CONFIG_NET_CONFIG_NEED_IPV4=y
CONFIG_NET_CONFIG_MY_IPV4_ADDR="192.0.2.1"
CONFIG_NET_CONFIG_MY_IPV4_GW="192.0.2.2"
CONFIG_NET_CONFIG_MY_IPV4_NETMASK="255.255.255.0"

# =============================================================================
# zenoh-pico Module
# =============================================================================
CONFIG_ZENOH_PICO=y
CONFIG_ZENOH_PICO_TRANSPORT_TCP=y
CONFIG_ZENOH_PICO_LINK_SERIAL=n

# =============================================================================
# POSIX API (required for zenoh-pico)
# =============================================================================
CONFIG_POSIX_API=y
CONFIG_PTHREAD_IPC=y

# =============================================================================
# Timing
# =============================================================================
CONFIG_SYS_CLOCK_TICKS_PER_SEC=1000

# =============================================================================
# Entropy (for zenoh session IDs)
# =============================================================================
CONFIG_ENTROPY_GENERATOR=y
CONFIG_TEST_RANDOM_GENERATOR=y

# =============================================================================
# Logging
# =============================================================================
CONFIG_LOG=y
CONFIG_LOG_DEFAULT_LEVEL=3
CONFIG_PRINTK=y
CONFIG_EARLY_CONSOLE=y

# =============================================================================
# Debug (optional, disable for production)
# =============================================================================
CONFIG_DEBUG=y
CONFIG_DEBUG_INFO=y
```

## src/main_stub.c
```c
/*
 * nano-ros Zephyr Talker - C Stub
 *
 * This stub provides the Zephyr entry point and calls the Rust main function.
 * The actual application logic is in src/lib.rs (Rust).
 *
 * SPDX-License-Identifier: Apache-2.0
 */

#include <zephyr/kernel.h>

/* Rust entry point - defined in src/lib.rs */
extern void main(void);

/*
 * Note: When using zephyr-lang-rust, this stub may not be needed
 * as the Rust code can define the entry point directly.
 * This is provided for compatibility with various build configurations.
 */
```

## src/zenoh_shim.c
```c
/**
 * zenoh-pico shim for Rust FFI
 *
 * This file provides wrapper functions that handle zenoh-pico types
 * with correct memory management, avoiding struct size mismatches in Rust FFI.
 */

#include <zenoh-pico.h>
#include <string.h>

// Static storage for zenoh objects (single publisher use case)
static z_owned_config_t g_config;
static z_owned_session_t g_session;
static z_owned_publisher_t g_publisher;

/**
 * Initialize zenoh config with client mode and connect locator
 */
int zenoh_init_config(const char *locator) {
    z_config_default(&g_config);

    if (zp_config_insert(z_config_loan_mut(&g_config), Z_CONFIG_MODE_KEY, "client") < 0) {
        return -1;
    }

    if (locator != NULL) {
        if (zp_config_insert(z_config_loan_mut(&g_config), Z_CONFIG_CONNECT_KEY, locator) < 0) {
            return -2;
        }
    }

    return 0;
}

/**
 * Open zenoh session and start background tasks
 */
int zenoh_open_session(void) {
    if (z_open(&g_session, z_config_move(&g_config), NULL) < 0) {
        return -1;
    }

    if (zp_start_read_task(z_session_loan_mut(&g_session), NULL) < 0) {
        z_close(z_session_loan_mut(&g_session), NULL);
        return -2;
    }

    if (zp_start_lease_task(z_session_loan_mut(&g_session), NULL) < 0) {
        zp_stop_read_task(z_session_loan_mut(&g_session));
        z_close(z_session_loan_mut(&g_session), NULL);
        return -3;
    }

    return 0;
}

/**
 * Declare a publisher for the given key expression
 */
int zenoh_declare_publisher(const char *keyexpr) {
    z_view_keyexpr_t ke;
    if (z_view_keyexpr_from_str(&ke, keyexpr) < 0) {
        return -1;
    }

    if (z_declare_publisher(z_session_loan(&g_session), &g_publisher,
                            z_view_keyexpr_loan(&ke), NULL) < 0) {
        return -2;
    }

    return 0;
}

/**
 * Publish data to the declared publisher
 */
int zenoh_publish(const uint8_t *data, size_t len) {
    z_owned_bytes_t payload;
    if (z_bytes_copy_from_buf(&payload, data, len) < 0) {
        return -1;
    }

    if (z_publisher_put(z_publisher_loan(&g_publisher), z_bytes_move(&payload), NULL) < 0) {
        return -2;
    }

    return 0;
}

/**
 * Close the session and clean up
 */
void zenoh_close(void) {
    z_undeclare_publisher(z_publisher_move(&g_publisher));
    zp_stop_lease_task(z_session_loan_mut(&g_session));
    zp_stop_read_task(z_session_loan_mut(&g_session));
    z_close(z_session_loan_mut(&g_session), NULL);
}
```
