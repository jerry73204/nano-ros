## CMakeLists.txt
```
# SPDX-License-Identifier: Apache-2.0
# nros Zephyr Service Server Example (C++) — TYPED component (RFC-0043 / phase-244.C2).
#
# Instead of a hand-written imperative `main.cpp`, the node is a stateful
# component (`AddTwoIntsServer::configure(node)`); the Zephyr typed carrier
# generates the entry (`nano_ros_add_node(... TYPED ...)` →
# ZephyrBoard::run_components).

cmake_minimum_required(VERSION 3.20.0)

find_package(Zephyr REQUIRED HINTS $ENV{ZEPHYR_BASE})
project(zephyr_cpp_service_server LANGUAGES CXX)

# nros module (CONFIG_NROS=y, CONFIG_NROS_CPP_API=y) provides zenoh shim,
# platform support, and the nros-cpp library automatically.

find_package(nano_ros REQUIRED)
find_package(example_interfaces REQUIRED)


# Phase 11W.12 — Cyclone DDS needs C `dds_topic_descriptor_t`s for each
# wire type. A service maps to a request + response topic, so generate
# both descriptors from example_interfaces/srv/AddTwoInts.srv (the
# converter emits the _Request_ / _Response_ structs) and compile them
# into the app.
if(CONFIG_NROS_RMW_CYCLONEDDS)
    list(APPEND CMAKE_MODULE_PATH "${NROS_CYCLONE_CMAKE_DIR}")
    set(IDLC_EXECUTABLE "${NROS_CYCLONE_IDLC}" CACHE FILEPATH "" FORCE)
    set(ENV{NROS_RMW_CYCLONEDDS_SCRIPTS_DIR} "${NROS_CYCLONE_SCRIPTS_DIR}")
    include(NrosRmwCycloneddsTypeSupport)
    nros_rmw_cyclonedds_generate_from_msg(_nros_cyc_types
        PKG_NAME   example_interfaces
        PKG_DIR    "$ENV{NROS_EXAMPLE_INTERFACES_DIR}"
        INTERFACES srv/AddTwoInts.srv)
    target_sources(app PRIVATE ${_nros_cyc_types})
endif()

# The Zephyr typed carrier branch keys on NANO_ROS_PLATFORM=zephyr + DEPLOY
# zephyr + TARGET app + TYPED, and target_sources/target_link_libraries the
# generated entry + component lib into the global `app`. No second executable.

nano_ros_auto_add_library(add_two_ints_server_lib STATIC src/AddTwoIntsServer.cpp)

nros_components_register_node(add_two_ints_server_lib
    HEADER AddTwoIntsServer.hpp
    PLUGIN zephyr_cpp_service_server::AddTwoIntsServer
    EXECUTABLE add_two_ints_server
    SHAPE configure
    TYPED
    # phase-412 -- `ENTITIES` is retired. A standalone Zephyr application has
    # no launch file, so it has no contract sidecar to state itself in; what
    # this image creates is stated as the XRCE session caps in prj-xrce.conf,
    # which is what phase-412's own guidance leaves such an image ("a system
    # with no contract yet keeps its configured" knobs). See issue 1033.
)
```

## prj.conf
```kconfig
# Base config (Phase 168.4 collapsed shape). RMW choice + RMW-specific
# sizing come from prj-<rmw>.conf overlays.

CONFIG_LOG=y
CONFIG_LOG_DEFAULT_LEVEL=3
CONFIG_PRINTK=y
CONFIG_EARLY_CONSOLE=y
CONFIG_LOG_BACKEND_RTT=n

CONFIG_NETWORKING=y
CONFIG_NET_IPV4=y
CONFIG_NET_UDP=y
CONFIG_NET_SOCKETS=y
CONFIG_NET_L2_ETHERNET=y
CONFIG_NET_MAX_CONTEXTS=16
CONFIG_DNS_RESOLVER=n

CONFIG_SYS_CLOCK_TICKS_PER_SEC=1000

CONFIG_NROS=y
CONFIG_NROS_CPP_API=y
CONFIG_STD_CPP17=y

CONFIG_NET_LOG=y
CONFIG_NET_STATISTICS=y
```

## prj-xrce.conf
```kconfig
CONFIG_NROS_RMW_XRCE=y
CONFIG_NROS_XRCE_AGENT_ADDR="127.0.0.1"
CONFIG_NROS_XRCE_AGENT_PORT=2018

CONFIG_NET_TCP=y

CONFIG_MAIN_STACK_SIZE=16384
CONFIG_HEAP_MEM_POOL_SIZE=65536
CONFIG_SYSTEM_WORKQUEUE_STACK_SIZE=4096

CONFIG_NET_PKT_RX_COUNT=32
CONFIG_NET_PKT_TX_COUNT=32
CONFIG_NET_BUF_RX_COUNT=64
CONFIG_NET_BUF_TX_COUNT=64

# issue 1033 -- the XRCE session struct is one heap allocation sized from these
# three caps, and the crate defaults (8 subscribers / 4 service servers / 4
# service clients) cost 309,696 bytes against the 65,536-byte heap above -- the
# image cannot boot. They are STATED rather than derived because a standalone
# Zephyr application reaches no entity inventory: it calls no `nano_ros_entry`,
# and phase-412 retired the `ENTITIES` declaration that used to feed the
# standalone composer.
#
# This image creates: service_server:example_interfaces/srv/AddTwoInts:/add_two_ints
# so: one service server; nothing subscribes and nothing calls out.
CONFIG_NROS_XRCE_MAX_SUBSCRIBERS=0
CONFIG_NROS_XRCE_MAX_SERVICE_SERVERS=1
CONFIG_NROS_XRCE_MAX_SERVICE_CLIENTS=0
```

## src/AddTwoIntsServer.cpp
```c
/// @file AddTwoIntsServer.cpp
/// @brief Zephyr C++ AddTwoInts service server — typed component.

#include "AddTwoIntsServer.hpp"

#include <cstdio>

namespace zephyr_cpp_service_server {

static int64_t read_i64_le(const uint8_t* p) {
    uint64_t v = 0;
    for (int i = 0; i < 8; ++i) {
        v |= static_cast<uint64_t>(p[i]) << (8 * i);
    }
    return static_cast<int64_t>(v);
}

static void write_i64_le(uint8_t* p, int64_t x) {
    uint64_t v = static_cast<uint64_t>(x);
    for (int i = 0; i < 8; ++i) {
        p[i] = static_cast<uint8_t>(v >> (8 * i));
    }
}

bool AddTwoIntsServer::handle_add(const uint8_t* req, size_t req_len, uint8_t* resp,
                                  size_t resp_cap, size_t* resp_len) {
    // AddTwoInts request CDR: 4-byte encapsulation header, then int64 a, int64 b
    // (8-aligned within the payload → buffer offsets 4 and 12).
    if (req_len < 20 || resp_cap < 12) {
        return false;
    }
    int64_t a = read_i64_le(req + 4);
    int64_t b = read_i64_le(req + 12);
    int64_t sum = a + b;
    // Reply CDR: copy the request's encapsulation header, then int64 sum.
    resp[0] = req[0];
    resp[1] = req[1];
    resp[2] = req[2];
    resp[3] = req[3];
    write_i64_le(resp + 4, sum);
    *resp_len = 12;
    std::printf("Incoming request\na: %lld b: %lld\n", static_cast<long long>(a),
                static_cast<long long>(b));
    return true;
}

::rclcpp::Result AddTwoIntsServer::configure(::nros::Node& node) {
    // Unbuffered stdout — a full-buffered console can swallow the final
    // line(s) when the harness kills the QEMU before a flush.
    // `::setvbuf` (global) not `std::setvbuf` — Zephyr's minimal libcpp/picolibc
    // `<cstdio>` declares it in the global namespace only.
    ::setvbuf(stdout, nullptr, _IONBF, 0);
    ::rclcpp::Result r = ::nros::bind_service_raw<AddTwoIntsServer, &AddTwoIntsServer::handle_add>(
        node, "/add_two_ints", "example_interfaces/srv/AddTwoInts", this);
    if (r.ok()) {
        // Readiness marker the e2e harness greps before driving the client.
        std::printf("Waiting for service requests\n");
    }
    return r;
}

} // namespace zephyr_cpp_service_server
```

## src/AddTwoIntsServer.hpp
```c
// Zephyr C++ AddTwoInts service server — typed component (RFC-0043, phase-244.C2).
//
// `configure` binds the member `handle_add` (by identity) as a raw callback-
// style service on `/add_two_ints`; the real handler decodes the CDR request
// (int64 a, b) and writes the CDR reply (int64 sum). No interpreter synthesis.
#ifndef NROS_ZEPHYR_SERVICE_SERVER_CPP_ADDTWOINTSSERVER_HPP
#define NROS_ZEPHYR_SERVICE_SERVER_CPP_ADDTWOINTSSERVER_HPP

#include <cstddef>
#include <cstdint>

#include <nros/component.hpp>
#include <nros/nros.hpp>

namespace zephyr_cpp_service_server {

class AddTwoIntsServer {
    // Real handler bound by identity: fills `resp` from `req`, returns true to
    // send the reply. (No callback name, no ctx arg — `this` is the executor ctx.)
    bool handle_add(const uint8_t* req, size_t req_len, uint8_t* resp, size_t resp_cap,
                    size_t* resp_len);

  public:
    ::rclcpp::Result configure(::nros::Node& node);
};

} // namespace zephyr_cpp_service_server

#endif
```
