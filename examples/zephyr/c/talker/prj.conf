## CMakeLists.txt
```
# SPDX-License-Identifier: Apache-2.0
# nros Zephyr Talker (C) — TYPED component (RFC-0043 / phase-244.C2).
#
# Instead of a hand-written imperative `main.c`, the node is a stateful C
# component (`NROS_C_COMPONENT(talker_t, talker_configure)`); the Zephyr typed
# carrier (the shared entry pack) generates the entry + composes it
# into `app`. The generated typed C bindings (std_msgs) provide the message
# struct + serializer (phase-277 W4; was hand-rolled CDR).

cmake_minimum_required(VERSION 3.20.0)

find_package(Zephyr REQUIRED HINTS $ENV{ZEPHYR_BASE})
project(nros_zephyr_talker_c)

# package.xml SSoT: generate the typed C bindings for the interface closure
# (std_msgs) into `app` — same call the zephyr C service/action examples use.

# Phase 11W.12 — Cyclone DDS needs a C `dds_topic_descriptor_t` for
# each message type (the backend's `find_descriptor` looks it up by
# mangled name). The nros C codegen emits the rcl-style C message
# struct but not Cyclone's descriptor, so generate it here from
# std_msgs/String and compile it into the app.
if(CONFIG_NROS_RMW_CYCLONEDDS)
    # The nano-ros Zephyr module exports NROS_CYCLONE_* and its cmake
    # helper dir; pull the helper onto the module path by exported name
    # (no repo-tree walk) so include() resolves it copy-out clean.
    list(APPEND CMAKE_MODULE_PATH "${NROS_CYCLONE_CMAKE_DIR}")
    set(IDLC_EXECUTABLE "${NROS_CYCLONE_IDLC}" CACHE FILEPATH "" FORCE)
    set(ENV{NROS_RMW_CYCLONEDDS_SCRIPTS_DIR} "${NROS_CYCLONE_SCRIPTS_DIR}")
    include(NrosRmwCycloneddsTypeSupport)
    nros_rmw_cyclonedds_generate_from_msg(_nros_cyc_types
        PKG_NAME   std_msgs
        PKG_DIR    "$ENV{NROS_STD_MSGS_DIR}"
        INTERFACES msg/String.msg)
    target_sources(app PRIVATE ${_nros_cyc_types})
endif()

# The Zephyr typed carrier branch (LANGUAGE C) configure_files
# the shared entry pack (`nros codegen entry-node`) + compiles src/Talker.c with
# -DNROS_PKG_NAME=<pkg sym> so its NROS_C_COMPONENT seam links against the
# generated entry, all into the global `app`. No second executable.
find_package(nano_ros REQUIRED)
find_package(std_msgs REQUIRED)

nano_ros_auto_add_library(talker_lib STATIC src/Talker.c)

nros_components_register_node(talker_lib
    PLUGIN nros_zephyr_talker_c::Talker
    EXECUTABLE talker
    SHAPE configure
    TYPED)
```

## prj.conf
```kconfig
# Base config for Zephyr C talker (Phase 168.4 collapsed shape).
# RMW choice + RMW-specific sizing come from prj-<rmw>.conf overlays.

CONFIG_LOG=y
CONFIG_LOG_DEFAULT_LEVEL=3
CONFIG_PRINTK=y
CONFIG_EARLY_CONSOLE=y
CONFIG_LOG_BACKEND_RTT=n

CONFIG_NETWORKING=y
CONFIG_NET_IPV4=y
CONFIG_NET_UDP=y
CONFIG_NET_SOCKETS=y
CONFIG_NET_L2_ETHERNET=y
CONFIG_NET_MAX_CONTEXTS=16
CONFIG_DNS_RESOLVER=n

CONFIG_SYS_CLOCK_TICKS_PER_SEC=1000

CONFIG_NROS=y
CONFIG_NROS_C_API=y
# Phase 244.C2 — the TYPED Zephyr carrier entry is C++ (drives the C component's
# factory/configure seam via ZephyrBoard::run_components), so the nros-cpp header
# surface must be on the app include path, and the carrier compiles as C++17
# (nros-cpp qos.hpp uses mutating constexpr members).
CONFIG_NROS_CPP_API=y
CONFIG_STD_CPP17=y

CONFIG_NET_LOG=y
CONFIG_NET_STATISTICS=y
```

## src/Talker.c
```c
/// @file Talker.c
/// @brief Zephyr C talker — typed component (RFC-0043 / phase-244.C2).
///
/// `talker_configure` creates a publisher on `/chatter` + a timer that
/// publishes the official ROS 2 demo payload (`std_msgs/String`,
/// `Hello World: N`) each tick, via the GENERATED typed C bindings
/// (`nros_find_interfaces(LANGUAGE C)` in CMakeLists — phase-277 W4; was
/// hand-rolled CDR). `NROS_C_COMPONENT` emits the C-ABI factory/configure the
/// Zephyr typed Entry carrier (the shared entry pack) calls.

#include <stddef.h>
#include <stdint.h>
#include <stdio.h>

#include <nros/component.h>

#include <std_msgs/msg/std_msgs_msg_string.h>

typedef struct {
    _Alignas(8) uint8_t pub[NROS_C_PUBLISHER_STORAGE_SIZE];
    int32_t count;
    /* Message + CDR scratch live in the component (not the tick stack):
     * String is ~256 B and RTOS timer/app stacks are small. */
    std_msgs_msg_string msg;
    uint8_t buf[300];
} talker_t;

static void on_tick(void* ctx) {
    talker_t* self = (talker_t*)ctx;
    /* Pre-increment so the first payload is "Hello World: 1", matching the
     * official ROS 2 demo talker. */
    self->count++;
    std_msgs_msg_string_init(&self->msg);
    snprintf(self->msg.data, sizeof(self->msg.data), "Hello World: %d", (int)self->count);
    /* Serialize via the generated typed serializer, publish through the
     * component (nros-cpp) raw seam. Buffer: 4-byte CDR header + 4-byte
     * length + payload + NUL. */
    size_t len = 0;
    if (std_msgs_msg_string_serialize(&self->msg, self->buf, sizeof(self->buf), &len) == 0 &&
        nros_cpp_publish_raw(self->pub, self->buf, len) == 0) {
        printf("Publishing: '%s'\n", self->msg.data);
    }
}

static nros_ret_t talker_configure(const nros_cpp_node_t* node, void* executor, talker_t* self) {
    setvbuf(stdout, NULL, _IONBF, 0);
    self->count = 0;
    int32_t rc = nros_cpp_publisher_create(node, "/chatter", std_msgs_msg_string_get_type_name(),
                                           "", nros_c_qos_default(), self->pub);
    if (rc != 0) {
        return rc;
    }
    size_t timer_handle;
    return nros_cpp_timer_create(executor, /*period_ms=*/500, on_tick, self, &timer_handle);
}

NROS_C_COMPONENT(talker_t, talker_configure)
```
