/****************************************************************************
 * nano-ros uORB → RMW bridge (phase-325 W3, issue 0362)
 *
 * WHAT THIS IS, AND WHY IT IS NOT THE W2 DEMO
 *
 *   examples/px4/cpp/firmware (W2) proves the ZERO-COPY property: nano-ros
 *   publishes a PX4 struct into uORB with no serialization, and a stock PX4
 *   `listener` reads it. Nothing is encoded because nothing needs to be.
 *
 *   This module proves REACH: the same in-firmware process reads uORB and
 *   re-publishes on a networked backend, so a real ROS 2 subscriber sees the
 *   data. The serialization uORB avoids comes back HERE, at the RMW boundary —
 *   necessarily, and that is the honest framing (phase-325 W4.3). Zero-copy is
 *   NOT claimed for this path.
 *
 * TWO SESSIONS, OPENED UP FRONT (issue 0436)
 *
 *   `nros::init()` opens exactly ONE session, and `NodeBuilder::rmw(name)` only
 *   binds a node to a session that ALREADY exists — so the single-session shape
 *   (what the phase-325 W3 note suggested) can never give a bridge its outward
 *   session. The supported shape is `nros::MultiExecutor` + `SessionSpec`
 *   (`nros/bridge.hpp`, phase-128 F.5): every backend session is named in one spec
 *   list, `specs[0]` becomes primary, and each Node is created on that handle.
 *
 * WHY THE TRANSLATION IS FIELD-BY-FIELD AND NOT A memcpy
 *
 *   Both structs are generated from the same `.msg`, so the field NAMES match —
 *   but the layouts do not. PX4 reorders for packing and appends explicit
 *   padding:
 *
 *     PX4  debug_key_value_s        { uint64 timestamp; float value; char key[10]; uint8
 *_padding0[2]; } ROS  px4_msgs::msg::DebugKeyValue { uint64 timestamp; char key[10]; float value; }
 *
 *   A memcpy would silently transpose `key` and `value`. The map below is
 *   therefore written out, and `char[N]` is copied with its NUL terminator
 *   intact because the CDR side reads it as a string (see `fixed_str` in the
 *   bridge's FFI crate).
 *
 * WHY THE TYPE HASH MATTERS HERE AND NOT IN W2
 *
 *   On uORB, topic identity is the `orb_metadata` pointer and the ROS type name
 *   is ignored. On the wire, `rmw_zenoh` keys discovery on the RIHS01 type hash:
 *   a guessed hash is either invisible to ROS 2 or — worse — matches the wrong
 *   type. So the outward type comes from `nros generate-px4-msgs --lang cpp`,
 *   which computes the same hash the Rust `px4_msgs` crate carries (issue 0362).
 ****************************************************************************/

#include <nros/nros.hpp>

#include <px4_platform_common/defines.h>
#include <px4_platform_common/log.h>
#include <px4_platform_common/module.h>
#include <px4_platform_common/posix.h>
#include <px4_platform_common/px4_work_queue/ScheduledWorkItem.hpp>

#include <uORB/topics/debug_key_value.h>

#include "nros_rmw_uorb.h"
#include "nros_rmw_uorb_registry.h"

// Generated by `nros generate-px4-msgs --lang cpp --topics debug_key_value`.
// Carries the struct, TYPE_NAME (`px4_msgs::msg::dds_::DebugKeyValue_` — what a
// ROS 2 subscriber of PX4's own XRCE client already matches) and the real RIHS01.
#include <px4_msgs/msg/debug_key_value.hpp>

#include <cstring>
#include <memory>
#include <cstdlib>

// Generated by nros_px4_add_module() from the BACKENDS list.
extern "C" void nros_app_register_backends(void);

using namespace time_literals;

namespace {

// The uORB side: a ROS-style name mapped to `ORB_ID(debug_key_value)` below.
constexpr const char* kInTopic = "/fmu/out/debug_key_value";
// The wire side: the topic a ROS 2 node subscribes.
constexpr const char* kOutTopic = "/fmu/out/debug_key_value";

// Where the outward session dials. `$NROS_LOCATOR` overrides; this is the zenoh
// default endpoint so a plain `zenohd` on the same host just works.
constexpr const char* kDefaultOutLocator = "tcp/127.0.0.1:7447";

// TWO sessions on ONE executor (issue 0436). Caller-owned executor storage,
// exactly like `nros::init()`'s global storage — `nros_cpp_init_multi` carves the
// executor in place inside it, so it must outlive the module.
alignas(8) uint8_t g_exec_storage[NROS_CPP_EXECUTOR_STORAGE_SIZE];

// The outward backend, chosen when libnros_cpp.a was built
// (`--features rmw-<name>-cffi`) and named here so session selection does not
// depend on registration order.
#ifndef NROS_BRIDGE_RMW
#define NROS_BRIDGE_RMW "zenoh"
#endif

/// The whole point of the module: PX4 struct → ROS/CDR struct.
///
/// Field-by-field because the layouts differ (see the header comment). Kept as a
/// free function so it is trivially unit-testable and so a second topic is a
/// second function rather than more branches in `Run()`.
void translate(const debug_key_value_s& in, px4_msgs::msg::DebugKeyValue& out) {
    out.timestamp = in.timestamp;
    out.value = in.value;
    // `char[10]`, NUL-terminated. Copy at most capacity-1 and terminate, so the
    // CDR side's `fixed_str` (which stops at the first NUL) never reads past the
    // data — the bytes after a terminator are uninitialized.
    static_assert(sizeof(out.key) >= sizeof(in.key), "ROS key buffer smaller than PX4's");
    std::memset(out.key, 0, sizeof(out.key));
    std::memcpy(out.key, in.key, sizeof(in.key));
    out.key[sizeof(out.key) - 1] = '\0';
}

} // namespace

class NrosUorbBridge : public ModuleBase<NrosUorbBridge>, public px4::ScheduledWorkItem {
  public:
    NrosUorbBridge();
    ~NrosUorbBridge() override = default;

    static int task_spawn(int argc, char* argv[]);
    static int custom_command(int argc, char* argv[]);
    static int print_usage(const char* reason = nullptr);

    int print_status() override;
    bool init();

  private:
    void Run() override;

    nros::Node _in_node{};
    nros::Node _out_node{};
    rclcpp::Subscription<px4_msgs::msg::DebugKeyValue> _in_sub{};
    rclcpp::Publisher<px4_msgs::msg::DebugKeyValue> _out_pub{};

    uint32_t _forwarded{0};
    uint32_t _drops{0};
};

NrosUorbBridge::NrosUorbBridge()
    : ScheduledWorkItem(MODULE_NAME, px4::wq_configurations::lp_default) {}

bool NrosUorbBridge::init() {
    // uORB has no name-keyed metadata lookup, so teach the backend which
    // orb_metadata the inward ROS-style name means. The type NAME is ignored on
    // uORB (identity is the metadata pointer) but is load-bearing outward.
    if (nros_rmw_uorb_register_topic(kInTopic, px4_msgs::msg::DebugKeyValue::TYPE_NAME,
                                     ORB_ID(debug_key_value)) != NROS_RMW_RET_OK) {
        PX4_ERR("register_topic(%s) failed", kInTopic);
        return false;
    }

    // BOTH sessions up front. `specs[0]` is primary; the uORB session ignores its
    // locator (in-process broker), the networked one takes the executor default
    // unless overridden. The backends must be REGISTERED first — the generated
    // `nros_app_register_backends()` (from `BACKENDS uorb zenoh`) does that.
    // Register the backends FIRST. `nros_init_multi` — unlike `nros_cpp_init`,
    // which `nros::init()` calls — does NOT invoke the generated
    // `nros_app_register_backends()`, so on the MultiExecutor path nothing has
    // populated the registry yet and both `open_with_rmw` lookups would miss
    // (issue 0436). The generated strong def comes from `BACKENDS uorb zenoh`.
    nros_app_register_backends();

    // The outward session needs a real locator: `SessionSpec` carries its own (it
    // does NOT inherit an executor default — there is no executor yet). uORB
    // ignores its locator entirely (in-process broker).
    const char* out_locator = getenv("NROS_LOCATOR");

    if (out_locator == nullptr || out_locator[0] == '\0') {
        out_locator = kDefaultOutLocator;
    }

    PX4_INFO("outward %s locator: %s", NROS_BRIDGE_RMW, out_locator);
    // Issue 0436 — `nros_cpp_init_multi` (NOT `nros_init_multi`/`MultiExecutor`):
    // it opens the sessions into a real `CppContext`, which is the handle type
    // `nros::Node` / `NodeBuilder` expect. The bridge crate's handle is a different
    // struct behind the same `void*`; both start with an `Executor` so the cast
    // reads fine and then writes over the box's `Vec` — PX4 dumped core.
    //
    // NROS_BRIDGE_PROBE=zenoh|uorb opens a SINGLE session, for isolating which
    // backend fails; unset = the real two-session bridge.
    const char* probe = getenv("NROS_BRIDGE_PROBE");

    NrosCppSessionSpec specs[2] = {};
    size_t n_specs = 0;

    if (probe != nullptr && strcmp(probe, "zenoh") == 0) {
        specs[0] = NrosCppSessionSpec{NROS_BRIDGE_RMW, out_locator, 0, "px4_probe", nullptr};
        n_specs = 1;

    } else if (probe != nullptr && strcmp(probe, "uorb") == 0) {
        specs[0] = NrosCppSessionSpec{"uorb", "", 0, "px4_probe", nullptr};
        n_specs = 1;

    } else {
        // specs[0] is PRIMARY: uORB, the inward side.
        specs[0] = NrosCppSessionSpec{"uorb", "", 0, "px4_bridge_in", nullptr};
        specs[1] = NrosCppSessionSpec{NROS_BRIDGE_RMW, out_locator, 0, "px4_bridge_out", nullptr};
        n_specs = 2;
    }

    {
        auto ret = nros_cpp_init_multi(specs, n_specs, g_exec_storage);

        if (ret != NROS_CPP_RET_OK) {
            PX4_ERR("nros_cpp_init_multi(uorb + %s) failed: ret=%d", NROS_BRIDGE_RMW,
                    static_cast<int>(ret));
            return false;
        }
    }

    void* exec = g_exec_storage;

    // Inward node on the PRIMARY (uORB) session.
    if (!nros::create_node_on(_in_node, exec, "px4_bridge_in").ok()) {
        PX4_ERR("create_node_on(in) failed");
        return false;
    }

    // Outward node bound to the named networked session.
    {
        auto r = nros::NodeBuilder(exec, "px4_bridge_out").rmw(NROS_BRIDGE_RMW).build(_out_node);

        if (!r.ok()) {
            PX4_ERR("bind outward node to %s failed: code=%d", NROS_BRIDGE_RMW,
                    static_cast<int>(r.code()));
            return false;
        }
    }

    if (!_in_node.create_subscription(_in_sub, kInTopic).ok()) {
        PX4_ERR("create_subscription(%s) failed", kInTopic);
        return false;
    }

    if (!_out_node.create_publisher(_out_pub, kOutTopic).ok()) {
        PX4_ERR("create_publisher(%s) on %s failed", kOutTopic, NROS_BRIDGE_RMW);
        return false;
    }

    PX4_INFO("bridging %s (uorb) -> %s (%s)", kInTopic, kOutTopic, NROS_BRIDGE_RMW);
    ScheduleOnInterval(200_ms);
    return true;
}

void NrosUorbBridge::Run() {
    if (should_exit()) {
        ScheduleClear();
        exit_and_cleanup();
        return;
    }

    // Inward: raw PX4 bytes, no decode (this half is still zero-copy).
    uint8_t buf[sizeof(debug_key_value_s)];
    size_t len = 0;

    if (!_in_sub.take_serialized(buf, sizeof(buf), len).ok() || len < sizeof(debug_key_value_s)) {
        return;
    }

    const auto* in = reinterpret_cast<const debug_key_value_s*>(buf);

    // Translate, then publish TYPED — the typed path is what CDR-encodes with the
    // generated type's hash, which is what makes a ROS 2 peer able to see it.
    px4_msgs::msg::DebugKeyValue out{};
    translate(*in, out);

#ifdef NROS_BRIDGE_INWARD_ONLY
    (void)out;
    _forwarded++;
    if (false) {
#else
    if (_out_pub.publish(out).ok()) {
#endif
        _forwarded++;

        if (_forwarded == 1 || (_forwarded % 25) == 0) {
            PX4_INFO("forwarded %u samples (key=%s value=%.1f)", static_cast<unsigned>(_forwarded),
                     out.key, static_cast<double>(out.value));
        }

    } else {
        _drops++;
    }
}

int NrosUorbBridge::print_status() {
    PX4_INFO("forwarded: %u  drops: %u", static_cast<unsigned>(_forwarded),
             static_cast<unsigned>(_drops));
    return 0;
}

int NrosUorbBridge::task_spawn(int argc, char* argv[]) {
    NrosUorbBridge* instance = new NrosUorbBridge();

    if (!instance) {
        PX4_ERR("alloc failed");
        return PX4_ERROR;
    }

    _object.store(instance);
    _task_id = task_id_is_work_queue;

    if (!instance->init()) {
        delete instance;
        _object.store(nullptr);
        _task_id = -1;
        return PX4_ERROR;
    }

    return PX4_OK;
}

int NrosUorbBridge::custom_command(int argc, char* argv[]) {
    return print_usage("unknown command");
}

int NrosUorbBridge::print_usage(const char* reason) {
    if (reason) {
        PX4_WARN("%s", reason);
    }

    PRINT_MODULE_DESCRIPTION(
        R"DESCR_STR(
### Description
Bridges a uORB topic onto a networked RMW so a ROS 2 subscriber sees it.

Reads `/fmu/out/debug_key_value` through the uORB backend (raw PX4 struct, no
decode), translates it field-by-field into the generated CDR `px4_msgs` type, and
publishes it on the networked backend the archive was built with.

Zero-copy is NOT claimed for the outward half: the serialization uORB avoids
returns at the RMW boundary.
)DESCR_STR");

    PRINT_MODULE_USAGE_NAME("nros_uorb_bridge", "examples");
    PRINT_MODULE_USAGE_COMMAND("start");
    PRINT_MODULE_USAGE_DEFAULT_COMMANDS();
    return 0;
}

extern "C" __EXPORT int nros_uorb_bridge_main(int argc, char* argv[]) {
    return NrosUorbBridge::main(argc, argv);
}
