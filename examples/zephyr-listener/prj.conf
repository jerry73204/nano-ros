## CMakeLists.txt
```
# SPDX-License-Identifier: Apache-2.0
# nano-ros Zephyr Listener Example (Rust)
#
# A ROS 2 compatible subscriber running on Zephyr RTOS using nano-ros.
#
# Build:
#   source ~/nano-ros-workspace/env.sh
#   west build -b native_sim/native/64 nano-ros/examples/zephyr-listener
#
# Run:
#   ./build/zephyr/zephyr.exe

cmake_minimum_required(VERSION 3.20.0)

find_package(Zephyr REQUIRED HINTS $ENV{ZEPHYR_BASE})
project(nano_ros_listener_rs)

# Use shared C shim from zenoh-pico-shim-sys
# This provides the zenoh_shim_* API used by the Rust crate
set(SHIM_DIR ${CMAKE_CURRENT_SOURCE_DIR}/../../crates/zenoh-pico-shim-sys/c)
target_sources(app PRIVATE ${SHIM_DIR}/shim/zenoh_shim.c)
target_include_directories(app PRIVATE ${SHIM_DIR}/include)

# Disable Z_FEATURE_INTEREST to avoid write filter issues with multiple clients
# The interest feature causes _z_send_n_msg() to fail when multiple zenoh clients
# connect to the same router simultaneously. Disabling it makes pub/sub work.
# Z_FEATURE_MATCHING depends on Z_FEATURE_INTEREST, so disable both.
# Use zephyr_compile_definitions to affect all Zephyr targets including zenoh-pico
zephyr_compile_definitions(Z_FEATURE_INTEREST=0 Z_FEATURE_MATCHING=0)

# Build Rust application (zephyr-lang-rust is in west manifest)
rust_cargo_application()
```

## prj.conf
```kconfig
# nano-ros Zephyr Listener Configuration
#
# This configuration enables the necessary Zephyr subsystems
# for running nano-ros with zenoh-pico transport.

# General
CONFIG_MAIN_STACK_SIZE=4096
CONFIG_HEAP_MEM_POOL_SIZE=16384
CONFIG_SYSTEM_WORKQUEUE_STACK_SIZE=2048

# Networking (required for zenoh-pico)
CONFIG_NETWORKING=y
CONFIG_NET_IPV4=y
CONFIG_NET_TCP=y
CONFIG_NET_UDP=y
CONFIG_NET_SOCKETS=y
CONFIG_NET_SOCKETS_POSIX_NAMES=y

# Network buffers
CONFIG_NET_PKT_RX_COUNT=16
CONFIG_NET_PKT_TX_COUNT=16
CONFIG_NET_BUF_RX_COUNT=32
CONFIG_NET_BUF_TX_COUNT=32
CONFIG_NET_MAX_CONTEXTS=10

# DNS (optional)
CONFIG_DNS_RESOLVER=y

# Network interface
CONFIG_NET_L2_ETHERNET=y

# For QEMU testing
CONFIG_NET_QEMU_ETHERNET=y
CONFIG_NET_QEMU_USER=y

# Static IP configuration
CONFIG_NET_CONFIG_SETTINGS=y
CONFIG_NET_CONFIG_NEED_IPV4=y
CONFIG_NET_CONFIG_MY_IPV4_ADDR="192.0.2.3"
CONFIG_NET_CONFIG_MY_IPV4_GW="192.0.2.2"
CONFIG_NET_CONFIG_MY_IPV4_NETMASK="255.255.255.0"

# Logging
CONFIG_LOG=y
CONFIG_LOG_DEFAULT_LEVEL=3
CONFIG_NET_LOG=y

# POSIX API
CONFIG_POSIX_API=y
CONFIG_PTHREAD_IPC=y

# Timing
CONFIG_SYS_CLOCK_TICKS_PER_SEC=1000

# Entropy
CONFIG_ENTROPY_GENERATOR=y
CONFIG_TEST_RANDOM_GENERATOR=y
```

## boards/native_sim_native_64.conf
```kconfig
# Board-specific config for native_sim/native/64
# Sets the TAP interface name to zeth1 for the listener

CONFIG_ETH_NATIVE_POSIX_DRV_NAME="zeth1"
```

## src/main.c
```c
/*
 * nano-ros Zephyr Listener Example
 *
 * This example demonstrates a ROS 2 compatible subscriber using
 * zenoh-pico transport on Zephyr RTOS.
 *
 * Receives CDR-serialized std_msgs/Int32 messages, compatible
 * with ROS 2 nodes using rmw_zenoh.
 *
 * SPDX-License-Identifier: Apache-2.0
 */

#include <zephyr/kernel.h>
#include <zephyr/logging/log.h>
#include <string.h>

LOG_MODULE_REGISTER(nano_ros_listener, LOG_LEVEL_INF);

/* CDR Serialization constants */
#define CDR_HEADER_SIZE 4
#define INT32_MSG_SIZE (CDR_HEADER_SIZE + 4)

/* Topic key in rmw_zenoh format */
#define TOPIC_KEY "0//chatter/std_msgs::msg::dds_::Int32_/RIHS01_abc123"

/* Deserialize an Int32 message from CDR format */
static int deserialize_int32(const uint8_t *buf, size_t buf_len, int32_t *value)
{
    if (buf_len < INT32_MSG_SIZE) {
        return -1;
    }

    /* Verify CDR encapsulation header */
    if (buf[0] != 0x00 || buf[1] != 0x01 || buf[2] != 0x00 || buf[3] != 0x00) {
        LOG_WRN("Unexpected CDR header: %02x %02x %02x %02x",
                buf[0], buf[1], buf[2], buf[3]);
        /* Continue anyway - might be big-endian */
    }

    /* Read Int32 value (assuming little-endian) */
    *value = (int32_t)(
        ((uint32_t)buf[4] << 0) |
        ((uint32_t)buf[5] << 8) |
        ((uint32_t)buf[6] << 16) |
        ((uint32_t)buf[7] << 24)
    );

    return 0;
}

/* Callback for received messages
 *
 * Note: In a real implementation with zenoh-pico, this would be:
 *
 * void subscriber_callback(z_loaned_sample_t *sample, void *context) {
 *     const z_loaned_bytes_t *payload = z_sample_payload(sample);
 *     size_t len = z_bytes_len(payload);
 *     // Read and deserialize...
 * }
 */
static void handle_message(const uint8_t *data, size_t len)
{
    int32_t value;
    if (deserialize_int32(data, len, &value) == 0) {
        LOG_INF("Received: %d", value);
    } else {
        LOG_ERR("Failed to deserialize message");
    }
}

int main(void)
{
    LOG_INF("nano-ros Zephyr Listener Starting");
    LOG_INF("Subscribing to: /chatter (std_msgs/Int32)");

    /* Note: In a real implementation with zenoh-pico:
     *
     * 1. Open zenoh session:
     *    z_owned_config_t config;
     *    z_config_default(&config);
     *    z_owned_session_t session;
     *    z_open(&session, z_config_move(&config), NULL);
     *
     * 2. Create closure and declare subscriber:
     *    z_owned_closure_sample_t callback;
     *    z_closure_sample(&callback, subscriber_callback, NULL, NULL);
     *
     *    z_view_keyexpr_t keyexpr;
     *    z_view_keyexpr_from_str(&keyexpr, TOPIC_KEY);
     *
     *    z_owned_subscriber_t sub;
     *    z_declare_subscriber(z_session_loan(&session), &sub,
     *                         z_view_keyexpr_loan(&keyexpr),
     *                         z_closure_sample_move(&callback), NULL);
     *
     * 3. Run event loop or use polling
     */

    /* Simulate receiving messages for demonstration */
    uint8_t test_msg[INT32_MSG_SIZE] = {
        0x00, 0x01, 0x00, 0x00,  /* CDR header */
        0x2A, 0x00, 0x00, 0x00   /* Int32: 42 */
    };

    LOG_INF("Simulating received message...");
    handle_message(test_msg, sizeof(test_msg));

    /* In a real implementation, we'd wait for callbacks */
    while (1) {
        /* TODO: Call zp_read() to process incoming messages */
        /* zp_read(z_session_loan(&session), NULL); */
        k_sleep(K_MSEC(100));
    }

    return 0;
}
```

## src/zenoh_shim.c
```c
/**
 * zenoh-pico shim for Rust FFI
 *
 * This file provides wrapper functions that handle zenoh-pico types
 * with correct memory management, avoiding struct size mismatches in Rust FFI.
 *
 * Supports multiple publishers and subscribers with static storage.
 */

#include <zenoh-pico.h>
#include <string.h>

// Configuration
#define MAX_PUBLISHERS 4
#define MAX_SUBSCRIBERS 4

// Callback function type for Rust
typedef void (*rust_sample_callback_t)(const uint8_t *data, size_t len, void *ctx);

// Subscriber entry with callback
typedef struct {
    z_owned_subscriber_t subscriber;
    rust_sample_callback_t callback;
    void *ctx;
    bool active;
} subscriber_entry_t;

// Publisher entry
typedef struct {
    z_owned_publisher_t publisher;
    bool active;
} publisher_entry_t;

// Static storage for zenoh objects
static z_owned_config_t g_config;
static z_owned_session_t g_session;
static bool g_session_open = false;

static publisher_entry_t g_publishers[MAX_PUBLISHERS];
static subscriber_entry_t g_subscribers[MAX_SUBSCRIBERS];

/**
 * Internal callback that receives zenoh samples and forwards to Rust
 */
static void sample_handler(z_loaned_sample_t *sample, void *arg) {
    int idx = (int)(intptr_t)arg;
    if (idx < 0 || idx >= MAX_SUBSCRIBERS) {
        return;
    }

    subscriber_entry_t *entry = &g_subscribers[idx];
    if (!entry->active || entry->callback == NULL) {
        return;
    }

    // Get payload
    const z_loaned_bytes_t *payload = z_sample_payload(sample);

    // Copy bytes to slice
    z_owned_slice_t slice;
    if (z_bytes_to_slice(payload, &slice) == 0) {
        const uint8_t *data = z_slice_data(z_slice_loan(&slice));
        size_t len = z_slice_len(z_slice_loan(&slice));
        entry->callback(data, len, entry->ctx);
        z_slice_drop(z_slice_move(&slice));
    }
}

/**
 * Initialize zenoh config with client mode and connect locator
 */
int zenoh_init_config(const char *locator) {
    // Initialize storage
    memset(g_publishers, 0, sizeof(g_publishers));
    memset(g_subscribers, 0, sizeof(g_subscribers));

    z_config_default(&g_config);

    if (zp_config_insert(z_config_loan_mut(&g_config), Z_CONFIG_MODE_KEY, "client") < 0) {
        return -1;
    }

    if (locator != NULL) {
        if (zp_config_insert(z_config_loan_mut(&g_config), Z_CONFIG_CONNECT_KEY, locator) < 0) {
            return -2;
        }
    }

    return 0;
}

/**
 * Open zenoh session and start background tasks
 */
int zenoh_open_session(void) {
    if (z_open(&g_session, z_config_move(&g_config), NULL) < 0) {
        return -1;
    }

    if (zp_start_read_task(z_session_loan_mut(&g_session), NULL) < 0) {
        z_close(z_session_loan_mut(&g_session), NULL);
        return -2;
    }

    if (zp_start_lease_task(z_session_loan_mut(&g_session), NULL) < 0) {
        zp_stop_read_task(z_session_loan_mut(&g_session));
        z_close(z_session_loan_mut(&g_session), NULL);
        return -3;
    }

    g_session_open = true;
    return 0;
}

/**
 * Check if session is open
 */
int zenoh_is_session_open(void) {
    return g_session_open ? 1 : 0;
}

/**
 * Declare a publisher for the given key expression
 * Returns publisher handle (>= 0) on success, negative on error
 */
int zenoh_declare_publisher(const char *keyexpr) {
    // Find free slot
    int idx = -1;
    for (int i = 0; i < MAX_PUBLISHERS; i++) {
        if (!g_publishers[i].active) {
            idx = i;
            break;
        }
    }
    if (idx < 0) {
        return -1; // No free slots
    }

    z_view_keyexpr_t ke;
    if (z_view_keyexpr_from_str(&ke, keyexpr) < 0) {
        return -2;
    }

    if (z_declare_publisher(z_session_loan(&g_session), &g_publishers[idx].publisher,
                            z_view_keyexpr_loan(&ke), NULL) < 0) {
        return -3;
    }

    g_publishers[idx].active = true;
    return idx;
}

/**
 * Publish data using publisher handle
 */
int zenoh_publish(int handle, const uint8_t *data, size_t len) {
    if (handle < 0 || handle >= MAX_PUBLISHERS || !g_publishers[handle].active) {
        return -1;
    }

    z_owned_bytes_t payload;
    if (z_bytes_copy_from_buf(&payload, data, len) < 0) {
        return -2;
    }

    if (z_publisher_put(z_publisher_loan(&g_publishers[handle].publisher),
                        z_bytes_move(&payload), NULL) < 0) {
        return -3;
    }

    return 0;
}

/**
 * Undeclare a publisher
 */
int zenoh_undeclare_publisher(int handle) {
    if (handle < 0 || handle >= MAX_PUBLISHERS || !g_publishers[handle].active) {
        return -1;
    }

    z_undeclare_publisher(z_publisher_move(&g_publishers[handle].publisher));
    g_publishers[handle].active = false;
    return 0;
}

/**
 * Declare a subscriber for the given key expression
 * Returns subscriber handle (>= 0) on success, negative on error
 */
int zenoh_declare_subscriber(const char *keyexpr, rust_sample_callback_t callback, void *ctx) {
    // Find free slot
    int idx = -1;
    for (int i = 0; i < MAX_SUBSCRIBERS; i++) {
        if (!g_subscribers[i].active) {
            idx = i;
            break;
        }
    }
    if (idx < 0) {
        return -1; // No free slots
    }

    g_subscribers[idx].callback = callback;
    g_subscribers[idx].ctx = ctx;

    z_view_keyexpr_t ke;
    if (z_view_keyexpr_from_str(&ke, keyexpr) < 0) {
        return -2;
    }

    // Create closure for callback, passing index as context
    z_owned_closure_sample_t closure;
    z_closure_sample(&closure, sample_handler, NULL, (void *)(intptr_t)idx);

    if (z_declare_subscriber(z_session_loan(&g_session), &g_subscribers[idx].subscriber,
                             z_view_keyexpr_loan(&ke), z_closure_sample_move(&closure), NULL) < 0) {
        g_subscribers[idx].callback = NULL;
        g_subscribers[idx].ctx = NULL;
        return -3;
    }

    g_subscribers[idx].active = true;
    return idx;
}

/**
 * Undeclare a subscriber
 */
int zenoh_undeclare_subscriber(int handle) {
    if (handle < 0 || handle >= MAX_SUBSCRIBERS || !g_subscribers[handle].active) {
        return -1;
    }

    z_undeclare_subscriber(z_subscriber_move(&g_subscribers[handle].subscriber));
    g_subscribers[handle].active = false;
    g_subscribers[handle].callback = NULL;
    g_subscribers[handle].ctx = NULL;
    return 0;
}

/**
 * Close the session and clean up all resources
 */
void zenoh_close(void) {
    // Clean up publishers
    for (int i = 0; i < MAX_PUBLISHERS; i++) {
        if (g_publishers[i].active) {
            z_undeclare_publisher(z_publisher_move(&g_publishers[i].publisher));
            g_publishers[i].active = false;
        }
    }

    // Clean up subscribers
    for (int i = 0; i < MAX_SUBSCRIBERS; i++) {
        if (g_subscribers[i].active) {
            z_undeclare_subscriber(z_subscriber_move(&g_subscribers[i].subscriber));
            g_subscribers[i].active = false;
            g_subscribers[i].callback = NULL;
            g_subscribers[i].ctx = NULL;
        }
    }

    // Close session
    if (g_session_open) {
        zp_stop_lease_task(z_session_loan_mut(&g_session));
        zp_stop_read_task(z_session_loan_mut(&g_session));
        z_close(z_session_loan_mut(&g_session), NULL);
        g_session_open = false;
    }
}
```
