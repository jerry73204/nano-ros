## CMakeLists.txt
```
# SPDX-License-Identifier: Apache-2.0
# nano-ros Zephyr Talker Example (Rust)
#
# A ROS 2 compatible publisher running on Zephyr RTOS using nano-ros.
#
# Build:
#   source ~/nano-ros-workspace/env.sh
#   west build -b native_sim/native/64 nano-ros/examples/zephyr-talker
#
# Run:
#   ./build/zephyr/zephyr.exe

cmake_minimum_required(VERSION 3.20.0)

find_package(Zephyr REQUIRED HINTS $ENV{ZEPHYR_BASE})
project(nano_ros_talker_rs)

# Use shared C shim from zenoh-pico-shim-sys
# This provides the zenoh_shim_* API used by the Rust crate
set(SHIM_DIR ${CMAKE_CURRENT_SOURCE_DIR}/../../crates/zenoh-pico-shim-sys/c)
target_sources(app PRIVATE ${SHIM_DIR}/shim/zenoh_shim.c)
target_include_directories(app PRIVATE ${SHIM_DIR}/include)

# Disable Z_FEATURE_INTEREST to avoid write filter issues with multiple clients
# The interest feature causes _z_send_n_msg() to fail when multiple zenoh clients
# connect to the same router simultaneously. Disabling it makes pub/sub work.
# Z_FEATURE_MATCHING depends on Z_FEATURE_INTEREST, so disable both.
# Use zephyr_compile_definitions to affect all Zephyr targets including zenoh-pico
zephyr_compile_definitions(Z_FEATURE_INTEREST=0 Z_FEATURE_MATCHING=0)

# Build Rust application (zephyr-lang-rust is in west manifest)
rust_cargo_application()
```

## prj.conf
```kconfig
# nano-ros Zephyr Talker (Rust) Configuration
#
# This configuration enables Rust support, zenoh-pico, and networking.

# =============================================================================
# General
# =============================================================================
CONFIG_MAIN_STACK_SIZE=16384
CONFIG_HEAP_MEM_POOL_SIZE=65536
CONFIG_SYSTEM_WORKQUEUE_STACK_SIZE=4096

# =============================================================================
# Rust Support (zephyr-lang-rust)
# =============================================================================
CONFIG_RUST=y
CONFIG_RUST_ALLOC=y

# Use printk backend for logging (not RTT)
CONFIG_LOG_BACKEND_RTT=n

# =============================================================================
# Logging
# =============================================================================
CONFIG_LOG=y
CONFIG_LOG_DEFAULT_LEVEL=3
CONFIG_PRINTK=y
CONFIG_EARLY_CONSOLE=y

# =============================================================================
# Networking
# =============================================================================
CONFIG_NETWORKING=y
CONFIG_NET_IPV4=y
CONFIG_NET_TCP=y
CONFIG_NET_UDP=y
CONFIG_NET_SOCKETS=y

# Network buffers
CONFIG_NET_PKT_RX_COUNT=32
CONFIG_NET_PKT_TX_COUNT=32
CONFIG_NET_BUF_RX_COUNT=64
CONFIG_NET_BUF_TX_COUNT=64
CONFIG_NET_MAX_CONTEXTS=16

# Network interface
CONFIG_NET_L2_ETHERNET=y

# Static IP configuration
CONFIG_NET_CONFIG_SETTINGS=y
CONFIG_NET_CONFIG_NEED_IPV4=y
CONFIG_NET_CONFIG_MY_IPV4_ADDR="192.0.2.1"
CONFIG_NET_CONFIG_MY_IPV4_GW="192.0.2.2"
CONFIG_NET_CONFIG_MY_IPV4_NETMASK="255.255.255.0"

# DNS (optional)
CONFIG_DNS_RESOLVER=n

# =============================================================================
# POSIX API (required by zenoh-pico)
# =============================================================================
CONFIG_POSIX_API=y

# =============================================================================
# zenoh-pico
# =============================================================================
CONFIG_ZENOH_PICO=y
CONFIG_ZENOH_PICO_PUBLICATION=y
CONFIG_ZENOH_PICO_LINK_TCP=y
CONFIG_ZENOH_PICO_MULTI_THREAD=y

# =============================================================================
# Timing
# =============================================================================
CONFIG_SYS_CLOCK_TICKS_PER_SEC=1000

# =============================================================================
# Debug
# =============================================================================
CONFIG_DEBUG=y
CONFIG_DEBUG_INFO=y

# Network debug logging
CONFIG_NET_LOG=y
CONFIG_NET_STATISTICS=y
CONFIG_NET_SHELL=y
```

## boards/native_sim_native_64.conf
```kconfig
# Board-specific config for native_sim/native/64
# Sets the TAP interface name to zeth0 for the talker

CONFIG_ETH_NATIVE_POSIX_DRV_NAME="zeth0"
```

## src/main.c
```c
/*
 * nano-ros Zephyr Talker Example
 *
 * This example demonstrates a ROS 2 compatible publisher using
 * zenoh-pico transport on Zephyr RTOS.
 *
 * The message format is CDR-serialized std_msgs/Int32, compatible
 * with ROS 2 nodes using rmw_zenoh.
 *
 * SPDX-License-Identifier: Apache-2.0
 */

#include <zephyr/kernel.h>
#include <zephyr/logging/log.h>

LOG_MODULE_REGISTER(nano_ros_talker, LOG_LEVEL_INF);

/* Note: When zenoh-pico is available as a Zephyr module, include:
 * #include <zenoh-pico.h>
 *
 * For now, this is a placeholder that demonstrates the structure.
 */

/* CDR Serialization for std_msgs/Int32
 *
 * CDR Format:
 *   - 4 bytes: encapsulation header (0x00, 0x01, 0x00, 0x00 for LE)
 *   - 4 bytes: int32 data (little-endian)
 */
#define CDR_HEADER_SIZE 4
#define INT32_MSG_SIZE (CDR_HEADER_SIZE + 4)

/* Topic key in rmw_zenoh format:
 * <domain_id>/<topic_name>/<type_name>/RIHS01_<type_hash>
 */
#define TOPIC_KEY "0//chatter/std_msgs::msg::dds_::Int32_/RIHS01_abc123"

/* Serialize an Int32 message to CDR format */
static int serialize_int32(uint8_t *buf, size_t buf_len, int32_t value)
{
    if (buf_len < INT32_MSG_SIZE) {
        return -1;
    }

    /* CDR encapsulation header (little-endian) */
    buf[0] = 0x00;
    buf[1] = 0x01;
    buf[2] = 0x00;
    buf[3] = 0x00;

    /* Int32 value (little-endian) */
    buf[4] = (value >> 0) & 0xFF;
    buf[5] = (value >> 8) & 0xFF;
    buf[6] = (value >> 16) & 0xFF;
    buf[7] = (value >> 24) & 0xFF;

    return INT32_MSG_SIZE;
}

int main(void)
{
    LOG_INF("nano-ros Zephyr Talker Starting");
    LOG_INF("Topic: /chatter (std_msgs/Int32)");

    int32_t counter = 0;
    uint8_t msg_buf[INT32_MSG_SIZE];

    /* Note: In a real implementation with zenoh-pico:
     *
     * 1. Open zenoh session:
     *    z_owned_config_t config;
     *    z_config_default(&config);
     *    z_owned_session_t session;
     *    z_open(&session, z_config_move(&config), NULL);
     *
     * 2. Declare publisher:
     *    z_view_keyexpr_t keyexpr;
     *    z_view_keyexpr_from_str(&keyexpr, TOPIC_KEY);
     *    z_owned_publisher_t pub;
     *    z_declare_publisher(z_session_loan(&session), &pub,
     *                        z_view_keyexpr_loan(&keyexpr), NULL);
     *
     * 3. Publish messages in loop:
     *    z_owned_bytes_t payload;
     *    z_bytes_copy_from_buf(&payload, msg_buf, msg_len);
     *    z_publisher_put(z_publisher_loan(&pub), z_bytes_move(&payload), NULL);
     */

    while (1) {
        /* Serialize message */
        int msg_len = serialize_int32(msg_buf, sizeof(msg_buf), counter);
        if (msg_len < 0) {
            LOG_ERR("Serialization failed");
            continue;
        }

        LOG_INF("Publishing: %d (CDR bytes: %02x %02x %02x %02x %02x %02x %02x %02x)",
                counter,
                msg_buf[0], msg_buf[1], msg_buf[2], msg_buf[3],
                msg_buf[4], msg_buf[5], msg_buf[6], msg_buf[7]);

        /* TODO: Actually publish via zenoh-pico */
        /* z_publisher_put(...) */

        counter++;
        k_sleep(K_SECONDS(1));
    }

    return 0;
}
```
