## CMakeLists.txt
```
# SPDX-License-Identifier: Apache-2.0
# nano-ros Zephyr BYO starter app (zenoh, C) — TYPED component
# (RFC-0043 / phase-244.C4). The node is a stateful C component
# (`NROS_C_COMPONENT(talker_t, talker_configure)`); the nano-ros module's Zephyr
# typed carrier (the shared entry pack) generates the entry +
# composes it into `app` (ZephyrBoard::run_components) — no hand-written
# `nros_app_main`. The raw publisher carries the type name as a string, so no
# generated message headers are needed (copy this app + edit topic/logic).
cmake_minimum_required(VERSION 3.20.0)
find_package(Zephyr REQUIRED HINTS $ENV{ZEPHYR_BASE})
project(nano_ros_byo_talker)

# NROS_REPO_DIR is published as a CACHE var by the nano-ros Zephyr module
# (auto-loaded via find_package(Zephyr) when CONFIG_NROS=y).
set(NANO_ROS_PLATFORM zephyr)
include("${NROS_REPO_DIR}/cmake/NanoRosNodeRegister.cmake")

nano_ros_auto_add_library(byo_talker_lib STATIC src/Talker.c)

nros_components_register_node(byo_talker_lib
    PLUGIN nano_ros_byo_talker::Talker
    EXECUTABLE byo_talker
    SHAPE configure
    TYPED
    DEPLOY zephyr)
```

## prj.conf
```kconfig
# nano-ros Zephyr starter — zenoh RMW, C API (Phase 205.A).
# For xrce/cyclonedds see modules/nano-ros/examples/zephyr/c/talker (the full
# multi-RMW example with the per-RMW prj-<rmw>.conf overlays).

CONFIG_LOG=y
CONFIG_LOG_DEFAULT_LEVEL=3
CONFIG_PRINTK=y
CONFIG_EARLY_CONSOLE=y

# Networking (any networked RMW on QEMU / native_sim)
CONFIG_NETWORKING=y
CONFIG_NET_IPV4=y
CONFIG_NET_UDP=y
CONFIG_NET_TCP=y
CONFIG_NET_SOCKETS=y
CONFIG_NET_L2_ETHERNET=y
CONFIG_NET_MAX_CONTEXTS=16
CONFIG_DNS_RESOLVER=n
CONFIG_SYS_CLOCK_TICKS_PER_SEC=1000

# nano-ros: enable the module + the C API + the zenoh RMW.
# (ROS edition is a build-time Cargo feature, NOT a Kconfig symbol — do not set
# CONFIG_NROS_ROS_EDITION; Zephyr aborts on the undefined symbol.)
CONFIG_NROS=y
CONFIG_NROS_C_API=y
# Phase 244.C4 — the TYPED Zephyr carrier entry is C++ (drives the C component's
# factory/configure seam via ZephyrBoard::run_components), so the nros-cpp header
# surface must be on the app include path, and the carrier compiles as C++17
# (nros-cpp qos.hpp uses mutating constexpr members).
CONFIG_NROS_CPP_API=y
CONFIG_STD_CPP17=y
CONFIG_NROS_RMW_ZENOH=y

# zenoh-pico needs POSIX threads + a roomy heap/stack
CONFIG_POSIX_API=y
CONFIG_MAX_PTHREAD_MUTEX_COUNT=32
CONFIG_MAX_PTHREAD_COND_COUNT=16
CONFIG_POSIX_THREAD_THREADS_MAX=16
CONFIG_MAIN_STACK_SIZE=16384
CONFIG_HEAP_MEM_POOL_SIZE=65536
CONFIG_SYSTEM_WORKQUEUE_STACK_SIZE=4096
CONFIG_NET_PKT_RX_COUNT=32
CONFIG_NET_PKT_TX_COUNT=32
CONFIG_NET_BUF_RX_COUNT=64
CONFIG_NET_BUF_TX_COUNT=64
```

## src/Talker.c
```c
/// @file Talker.c
/// @brief nano-ros Zephyr BYO starter — zenoh C talker, typed component
/// (RFC-0043 / phase-244.C4).
///
/// `talker_configure` creates a raw publisher on `/chatter` + a timer that
/// publishes a CDR-encoded Int32 counter each tick. Copy this app, edit the
/// topic / message / logic. `NROS_C_COMPONENT` emits the C-ABI factory/configure
/// the Zephyr typed Entry carrier (the shared entry pack) calls;
/// the carrier runs it on the real executor (ZephyrBoard::run_components) — no
/// hand-written `nros_app_main`. Booting needs a zenoh router at
/// CONFIG_NROS_ZENOH_LOCATOR (e.g. `ZENOH_CONFIG_OVERRIDE='listen/endpoints=["tcp/127.0.0.1:7456`)."];scouting/multicast/enabled=false' ros2 run rmw_zenoh_cpp rmw_zenohd

#include <stddef.h>
#include <stdint.h>
#include <stdio.h>

#include <std_msgs/std_msgs.h>
#include <nros/component.h>

typedef struct {
    _Alignas(8) uint8_t pub[NROS_C_PUBLISHER_STORAGE_SIZE];
    int32_t count;
} talker_t;

static void on_tick(void* ctx) {
    talker_t* self = (talker_t*)ctx;
    std_msgs_msg_int32 msg;
    std_msgs_msg_int32_init(&msg);
    msg.data = self->count;
    uint8_t buf[16];
    size_t n = 0;
    if (std_msgs_msg_int32_serialize(&msg, buf, sizeof(buf), &n) == 0 &&
        nros_cpp_publish_raw(self->pub, buf, n) == 0) {
        printf("Published: %d\n", (int)self->count);
    }
    self->count++;
}

static nros_ret_t talker_configure(const nros_cpp_node_t* node, void* executor, talker_t* self) {
    setvbuf(stdout, NULL, _IONBF, 0);
    self->count = 0;
    int32_t rc = nros_cpp_publisher_create(node, "/chatter", std_msgs_msg_int32_get_type_name(), "",
                                           nros_c_qos_default(), self->pub);
    if (rc != 0) {
        return rc;
    }
    size_t timer_handle;
    return nros_cpp_timer_create(executor, /*period_ms=*/1000, on_tick, self, &timer_handle);
}

NROS_C_COMPONENT(talker_t, talker_configure)
```
