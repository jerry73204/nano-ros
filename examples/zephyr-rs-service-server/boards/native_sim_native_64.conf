## examples/zephyr-rs-service-server/boards/native_sim_native_64.conf
```kconfig
# Board-specific config for native_sim/native/64
# Sets the TAP interface name to zeth0 for the service server

CONFIG_ETH_NATIVE_POSIX_DRV_NAME="zeth0"
```
